## boards/shields/lily58/Kconfig.defconfig
```kconfig
if SHIELD_LILY58_LEFT

config ZMK_KEYBOARD_NAME
    default "Lily58"

config ZMK_SPLIT_ROLE_CENTRAL
    default y

endif


if SHIELD_LILY58_LEFT || SHIELD_LILY58_RIGHT || SHIELD_LILY58_LEFT_PERIPHERAL

config ZMK_SPLIT
    default y

if ZMK_DISPLAY

config I2C
    default y

config SSD1306
    default y

# --- Виджеты ---
# Левая половина — стандартные виджеты
if SHIELD_LILY58_LEFT
config ZMK_WIDGET_WPM_STATUS
    bool
    default y
config ZMK_WIDGET_LAYER_STATUS
    bool
    default y
config ZMK_WIDGET_BATTERY_STATUS
    bool
    default y
config ZMK_WIDGET_OUTPUT_STATUS
    bool
    default y
endif # SHIELD_LILY58_LEFT

# Правая половина — Bongo Cat (анимация пока закомментирована)
if SHIELD_LILY58_RIGHT
# config LV_USE_ANIMATION
#     bool
#     default y
# config ZMK_WIDGET_BONGO_CAT
#     bool
#     default y
#     select LV_USE_IMG
#     select LV_USE_ANIMATION
endif # SHIELD_LILY58_RIGHT

endif # ZMK_DISPLAY

if LVGL

config LV_Z_VDB_SIZE
    default 64

config LV_DPI_DEF
    default 148

config LV_Z_BITS_PER_PIXEL
    default 1

choice LV_COLOR_DEPTH
    default LV_COLOR_DEPTH_1
endchoice

endif # LVGL
```
