#if MC_TECHNOLOGY_MOUSE_ENABLE == 1
#    include <dt-bindings/zmk/mouse.h>

  &mmv {
    time-to-max-speed-ms = <1500>;     // 500
    acceleration-exponent=<1>;
    delay-ms = <0>;                   // 10
  };
  &mwh {
    time-to-max-speed-ms = <5000>;    // 2000
    acceleration-exponent=<1>;        // 0
    delay-ms = <0>;                   // 10
  };

  #undef CLICK_LEFT
  #undef CLICK_RIGHT
  #undef CLICK_MIDDLE
  #define CLICK_LEFT &mkp LCLK
  #define CLICK_RIGHT &mkp RCLK
  #define CLICK_MIDDLE &mkp MCLK

  #undef MOVE_UP
  #undef MOVE_DOWN
  #undef MOVE_LEFT
  #undef MOVE_RIGHT
  #define MOVE_UP &mmv MOVE_VERT(-2500)
  #define MOVE_DOWN &mmv MOVE_VERT(2500)
  #define MOVE_LEFT &mmv MOVE_HOR(-2500)
  #define MOVE_RIGHT &mmv MOVE_HOR(2500)

  #undef SCROLL_UP
  #undef SCROLL_DOWN
  #undef SCROLL_LEFT
  #undef SCROLL_RIGHT
  #define SCROLL_UP &mwh SCROLL_VERT(15)
  #define SCROLL_DOWN &mwh SCROLL_VERT(-15)
  #define SCROLL_LEFT &mwh SCROLL_HOR(-15)
  #define SCROLL_RIGHT &mwh SCROLL_HOR(15)

#else

  #undef CLICK_LEFT
  #undef CLICK_RIGHT
  #undef CLICK_MIDDLE
  #define CLICK_LEFT &none
  #define CLICK_RIGHT &none
  #define CLICK_MIDDLE &none

  #undef MOVE_UP
  #undef MOVE_DOWN
  #undef MOVE_LEFT
  #undef MOVE_RIGHT
  #define MOVE_UP &none
  #define MOVE_DOWN &none
  #define MOVE_LEFT &none
  #define MOVE_RIGHT &none

  #undef SCROLL_UP
  #undef SCROLL_DOWN
  #undef SCROLL_LEFT
  #undef SCROLL_RIGHT
  #define SCROLL_UP &none
  #define SCROLL_DOWN &none
  #define SCROLL_LEFT &none
  #define SCROLL_RIGHT &none

#endif
// vim: filetype=dts fdm=marker:
